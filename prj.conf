## CMakeLists.txt
```
# SPDX-License-Identifier: Apache-2.0

cmake_minimum_required(VERSION 3.20.0)

find_package(Zephyr REQUIRED HINTS $ENV{ZEPHYR_BASE})
project(can_project)

set(LVGL_DIR ${ZEPHYR_LVGL_MODULE_DIR})

target_compile_definitions(app PRIVATE LV_LVGL_H_INCLUDE_SIMPLE=1)
# target_compile_definitions(app PRIVATE CONFIG_LV_USE_DEMO_MUSIC=1)
# target_compile_definitions(app PRIVATE LV_USE_DEMO_MUSIC=1)



# include header file
include_directories(
        "${CMAKE_CURRENT_LIST_DIR}/include"
        "${CMAKE_CURRENT_LIST_DIR}/src"
        "${CMAKE_CURRENT_LIST_DIR}/src/application_process/receive_process"
        "${CMAKE_CURRENT_LIST_DIR}/src/application_process/gui_process"
        "${CMAKE_CURRENT_LIST_DIR}/src/low_level/CAN_device"
        "${CMAKE_CURRENT_LIST_DIR}/src/low_level/gui"
        "${CMAKE_CURRENT_LIST_DIR}/src/received_data"
        "${CMAKE_CURRENT_LIST_DIR}/src/application_process/event_handler"
        "${CMAKE_CURRENT_LIST_DIR}/src/test"
        "${CMAKE_CURRENT_LIST_DIR}/src/low_level/gui/gui_design/custom"
        "${CMAKE_CURRENT_LIST_DIR}/src/low_level/gui/gui_design/generated"
        "${CMAKE_CURRENT_LIST_DIR}/src/low_level/gui/gui_design/generated/guider_customer_fonts"
        "${ZEPHYR_LVGL_MODULE_DIR}/lvgl/src"
)

# src file
file(GLOB SRC_FILE
        "${CMAKE_CURRENT_LIST_DIR}/src/*.c"
        "${CMAKE_CURRENT_LIST_DIR}/src/application_process/receive_process/*.c"
        "${CMAKE_CURRENT_LIST_DIR}/src/application_process/gui_process/*.c"
        "${CMAKE_CURRENT_LIST_DIR}/src/low_level/CAN_device/*.c"
        "${CMAKE_CURRENT_LIST_DIR}/src/low_level/gui/*.c"
        "${CMAKE_CURRENT_LIST_DIR}/src/received_data/*.c"
        "${CMAKE_CURRENT_LIST_DIR}/src/application_process/event_handler/*.c"
        "${CMAKE_CURRENT_LIST_DIR}/src/test/*.c"
        "${CMAKE_CURRENT_LIST_DIR}/src/low_level/gui/gui_design/custom/*.c"
        "${CMAKE_CURRENT_LIST_DIR}/src/low_level/gui/gui_design/generated/*.c"
        "${CMAKE_CURRENT_LIST_DIR}/src/low_level/gui/gui_design/generated/guider_fonts/*.c"
        "${CMAKE_CURRENT_LIST_DIR}/src/low_level/gui/gui_design/generated/images/*.c"
        )

target_sources(app PRIVATE ${SRC_FILE})
```

## prj.conf
```kconfig
CONFIG_MAIN_STACK_SIZE=4096

CONFIG_CAN=y
CONFIG_CAN_STM32_BXCAN=y

CONFIG_LVGL=y
CONFIG_DISPLAY=y
CONFIG_LV_FONT_MONTSERRAT_12=y
CONFIG_LV_FONT_MONTSERRAT_14=y
CONFIG_LV_FONT_MONTSERRAT_16=y
CONFIG_LV_Z_MEM_POOL_SIZE=49152
CONFIG_LV_USE_GPU_STM32_DMA2D=y
CONFIG_LV_GPU_DMA2D_CMSIS_INCLUDE="stm32f7xx.h"
CONFIG_EVENTS=y

CONFIG_DEBUG_OPTIMIZATIONS=y
```

## app.overlay
```dts
&can1
{
	status = "okay";
	pinctrl-names = "default";
	pinctrl-0 = <&can1_rx_pb8 &can1_tx_pb9>;
};
```

## src/main.c
```c
#include <stdint.h>
#include <zephyr/kernel.h>
#include "receive_process.h"
#include "gui_process.h"
#include "test_can.h"
#include "event_handler.h"

int main(void)
{
    /* init receive thread */
    receive_process_init();

    /* init gui thread */
    gui_process_init();

    /* init test can */
    test_can_process_init();

    /* init event */
    event_init_global();

    /* start receive thread */
    receive_process_start();

    /* start gui thread */
    gui_process_start();

    /* start test can */
    test_can_process_start();

    return 0;

}
```
